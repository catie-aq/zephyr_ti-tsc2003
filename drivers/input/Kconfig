## drivers/input/Kconfig
```kconfig
# Copyright (c) 2024 CATIE
# SPDX-License-Identifier: Apache-2.0

if INPUT

rsource "ti/Kconfig"

endif # INPUT
```

## drivers/input/ti/tsc2003/Kconfig
```kconfig
# Copyright (c) 2024 CATIE
# SPDX-License-Identifier: Apache-2.0

menuconfig TSC2003
    bool "Texas Instruments tsc2003 touch screen controller sensor"
    default y
    depends on DT_HAS_TI_TSC2003_ENABLED
    select I2C
    help
      Enable driver for Texas Instruments tsc2003 touch screen controller sensor.

if TSC2003

  config TSC2003_DEBOUNCE_MS
    int "Debounce timeout millisecond"
    default 500
    help
      Timeout value for debounce filtering (milliseconds).

endif # TSC2003
```

## dts/bindings/input/ti,tsc2003.yaml
```yaml
# Copyright (c) 2024 CATIE
# SPDX-License-Identifier: Apache-2.0

description: |
    Texas Instruments tsc2003 touch screen controller sensor

compatible: "ti,tsc2003"

include: i2c-device.yaml

properties:
  reg:
    type: array
    description: |
      I2C address of the device.
  screen_width:
    type: int
    required: true
    description: Width of the touchscreen in pixels

  screen_height:
    type: int
    required: true
    description: Height of the touchscreen in pixels

  inverted_x:
    type: boolean
    description: Invert the X axis

  inverted_y:
    type: boolean
    description: Invert the Y axis

  swapped_x_y:
    type: boolean
    description: Swap the X and Y axes

  int-gpios:
    type: phandle-array
    description: GPIO specifier for the interrupt pin
```
